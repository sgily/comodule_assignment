## CMakeLists.txt
```
# SPDX-License-Identifier: Apache-2.0

cmake_minimum_required(VERSION 3.20.0)

find_package(Zephyr REQUIRED HINTS $ENV{ZEPHYR_BASE})
project(uart_echo_bot)

target_include_directories(app PRIVATE inc)
target_sources(app PRIVATE src/main.c src/parser.c src/bt.c)
```

## prj.conf
```kconfig
CONFIG_SERIAL=y
CONFIG_UART_INTERRUPT_DRIVEN=y
CONFIG_CBPRINTF_LIBC_SUBSTS=y
CONFIG_BT=y
CONFIG_BT_HCI=y
CONFIG_CBPRINTF_FP_SUPPORT=y
CONFIG_CBPRINTF_FULL_INTEGRAL=y
CONFIG_BT_DEVICE_NAME="SG: Kou assignment"
```

## src/main.c
```c
/*
 * Copyright (c) 2022 Libre Solar Technologies GmbH
 *
 * SPDX-License-Identifier: Apache-2.0
 */

#include <zephyr.h>
#include <device.h>
#include <drivers/uart.h>
#include <string.h>
#include <parser.h>
#include <bt.h>

/* change this to any other UART peripheral if desired */
#define UART_DEVICE_NODE DT_CHOSEN(zephyr_shell_uart)

#define MSG_SIZE 40 // Max input length

/* queue to store up to 10 messages (aligned to 4-byte boundary) */
K_MSGQ_DEFINE(uart_msgq, MSG_SIZE, 10, 4);

static const struct device *uart_dev = DEVICE_DT_GET(UART_DEVICE_NODE);

/* receive buffer used in UART ISR callback */
static char rx_buf[MSG_SIZE];
static int rx_buf_pos;


/*
 * Read characters from UART until line end is detected. Afterwards push the
 * data to the message queue.
 */
void serial_cb(const struct device *dev, void *user_data)
{
	uint8_t c;

	if (!uart_irq_update(uart_dev)) {
		return;
	}

	while (uart_irq_rx_ready(uart_dev)) {

		uart_fifo_read(uart_dev, &c, 1);

		if ((c == '\n' || c == '\r') && rx_buf_pos > 0) {
			/* terminate string */
			rx_buf[rx_buf_pos] = '\0';

			/* if queue is full, message is silently dropped */
			k_msgq_put(&uart_msgq, &rx_buf, K_NO_WAIT);

			/* reset the buffer (it was copied to the msgq) */
			rx_buf_pos = 0;
		} else if (rx_buf_pos < (sizeof(rx_buf) - 1)) {
			rx_buf[rx_buf_pos++] = c;
		}
		/* else: characters beyond buffer size are dropped */
	}
}

/*
 * Print a null-terminated string character by character to the UART interface
 */
void print_uart(char *buf)
{
	int msg_len = strlen(buf);

	for (int i = 0; i < msg_len; i++) {
		uart_poll_out(uart_dev, buf[i]);
	}
}

static void print_help() {
	print_uart("Supported format is Decimal Degrees\r\n");
	print_uart("e.g. 123.456789, 12.3456789\r\n");
	print_uart("If you see error, then check your input and try again\r\n");
}

static void flush(char* buf, size_t length) {
	for (int i=0; i<length; ++i) {
		buf[i] = 0;
	}
}

void main(void)
{
	char tx_buf[MSG_SIZE];
	int err;
	if (!device_is_ready(uart_dev)) {
		printk("UART device not found!");
		return;
	}
	/* configure interrupt and callback to receive data */
	uart_irq_callback_user_data_set(uart_dev, serial_cb, NULL);
	uart_irq_rx_enable(uart_dev);

	/* Enable bluetooth*/
	err = start_bt();
	if (err) {
		printk("Bluetooth initialization failed");
	}
	
	print_uart("Please type in GPS coordinates\r\n");
	print_help();

	/* indefinitely wait for input from the user */
	while (k_msgq_get(&uart_msgq, &tx_buf, K_FOREVER) == 0) {
		// parse buffer
		if (!strcmp("help", tx_buf)) {
			print_help();
		} else {
			// add comodule company id to the beginning
			// of advertising data
			char out_buf[26] = {0x0f, 0x02};
			err = format_coordinates(tx_buf, MSG_SIZE, &out_buf[2], ADV_SIZE-2);
			// if error, print error and wait again
			if (err) {
				switch (err)
				{
				case -EINVAL:
					print_uart("Bad input format, check for typing errors\r\n");
					break;
				case -ERANGE:
					print_uart("GPS data out of range\r\n");
					break;
				default:
					print_uart("Input parsing error\r\n");
					break;
				}
			} else {
				err = update_bt_data(out_buf, ARRAY_SIZE(out_buf));
				if (err)
					print_uart("Failed to update adv data\r\n");
				else
					print_uart("GPS location data updated\r\n");
			}
		}
		flush(tx_buf, ARRAY_SIZE(tx_buf));
		print_uart("\r\n");
	}
}
```

## inc/bt.h
```c
#ifndef BT_H_
#define BT_H_

#include <stddef.h>

#define ADV_SIZE 26
#define DEVICE_NAME "Kou task beacon"

int start_bt(void);
int update_bt_data(char buf[], size_t length);

#endif
```

## inc/parser.h
```c
#ifndef PARSER_H_
#define PARSER_H_

#include <stddef.h>

#define LATITUDE_MAX 90.0f
#define LATITUDE_MIN -90.0f
#define LONGITUDE_MAX 180.0f
#define LONGITUDE_MIN -180.0f

// struct for holding decimal degree data
typedef struct {
    double lat;
    double lon;
} dd_coordinates;

// parser interface
// params:
//  data_buf        input buffer
//  data_length     input buffer size
//  result_buf      outputbuffer for storing results
//  result_length   output buffer size
// return:
//  0 on success, error code on failure
int format_coordinates(const char* data_buf, size_t data_length, 
                        char* result_buf, size_t result_length);


#endif
```

## src/bt.c
```c
#include <bt.h>
#include <bluetooth/bluetooth.h>

//advertising data struct
static struct bt_data adv[] = {
	BT_DATA_BYTES(BT_DATA_FLAGS, BT_LE_AD_NO_BREDR),
	BT_DATA_BYTES(BT_DATA_MANUFACTURER_DATA,
		0x0f, 0x02) /* Comodule GmbH */
};

// bluetooth setup callback
static void bt_ready(int err)
{
	if (err) {
			printk("Bluetooth init failed (err %d)\n", err);
			return;
	}
	printk("Bluetooth initialized\n");
	/* Start advertising */
	err = bt_le_adv_start(BT_LE_ADV_NCONN_NAME, adv, ARRAY_SIZE(adv),
							NULL, 0);
	if (err) {
			printk("Advertising failed to start (err %d)\n", err);
			return;
	}
}

int start_bt(void) {
    return bt_enable(bt_ready);
}

int update_bt_data(char buf[], size_t length) {
    adv[1].data = buf;
	adv[1].data_len = length;
	return bt_le_adv_update_data(adv, ARRAY_SIZE(adv),NULL, 0);
}
```

## src/parser.c
```c
#include "parser.h"
#include <string.h>
#include <stdlib.h>
#include <zephyr.h>
#include <ctype.h>
#include <errno.h>
#include <sys/cbprintf.h>

// convert string to float
// on failure returns 0 and sets errno
static float strtod(char *str) {
    float res = 0, fact = 1;
    uint8_t point_found = 0;

    if (str == NULL) {
        errno = -EINVAL;
        return 0;
    }
    if (*str == '-') {
        fact = -1;
        ++str;
    }
    for(; *str != '\0'; ++str) {
        if (*str == '.') {
            point_found = 1;
        } else {
            int d = *str - '0';
            if (d >= 0 && d <= 9) {
                if (point_found)
                    fact /= 10;
                res = res*10.0f + d;
            } else {
                // error, return 0
                errno = -EINVAL;
                res = 0;
                break;
            }
        }
    }

    return res*fact;
}

// here token is the floating point number (latitude or longitude)
static int parse_dd_token(char *buf, double *result, char **saveptr) {
    int err = 0;
    char *tok;

    tok = strtok_r(buf, ":, ", saveptr);
    errno = 0;
    *result = strtod(tok);
    if (*result == 0 && errno)
        err = errno;

    return err;
}

static int validate_coordinates(dd_coordinates* dd) {
    int err = 0;

    if (dd->lat > LATITUDE_MAX || dd->lat < LATITUDE_MIN)
        err = -ERANGE;
    if (dd->lon > LONGITUDE_MAX || dd->lon < LONGITUDE_MIN)
        err = -ERANGE;

    return err;
}

// fills decimal degree data struct and validates results
static int parse_dd_location(const char* buf, size_t length, dd_coordinates* result) {
    int err = 0;
    char bufcpy[length];
    char *saveptr;

    //copy input buffer because it will be modified
    strcpy(bufcpy, buf);
    err = parse_dd_token(bufcpy, &result->lat, &saveptr);
    err = parse_dd_token(NULL, &result->lon, &saveptr);
    if (!err)
        err = validate_coordinates(result);
    
    return err;
}

// parse coordinates string and format it into string
// to up to 5 decimal places (beyond, the output getz fuzzy
// because of the rounding)
int format_coordinates(const char* data_buf, size_t data_length, 
                        char* result_buf, size_t result_length) {
    int err = 0;
    dd_coordinates res = {.lat = 0, .lon = 0};

    err = parse_dd_location(data_buf, data_length, &res);
    if (!err)
        snprintfcb(result_buf, result_length, "%3.5f %3.5f", res.lat, res.lon);
    
    return err;
}
```
